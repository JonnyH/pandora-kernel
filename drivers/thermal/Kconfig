## drivers/thermal/Kconfig
```kconfig
#
# Generic thermal sysfs drivers configuration
#

menuconfig THERMAL
	tristate "Generic Thermal sysfs driver"
	help
	  Generic Thermal Sysfs driver offers a generic mechanism for
	  thermal management. Usually it's made up of one or more thermal
	  zone and cooling device.
	  Each thermal zone contains its own temperature, trip points,
	  cooling devices.
	  All platforms with ACPI thermal support can use this driver.
	  If you want this support, you should say Y or M here.

config THERMAL_HWMON
	bool
	depends on THERMAL
	depends on HWMON=y || HWMON=THERMAL
	default y

config OMAP3_THERMAL
	bool "OMAP3/DM3730 band gap thermal sensor driver"
	depends on THERMAL
	depends on ARCH_OMAP
	help
	  Enable this to plug the OMAP3/DM3730 band gap thermal sensor driver
	  into the Linux thermal framework
```
